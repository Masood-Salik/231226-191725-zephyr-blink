## zephyr/boards/arm/stm32f437vi/Kconfig.board
```kconfig
# Custom board configuration

# Copyright (c) 2023 Your Name.
# SPDX-License-Identifier: Apache-2.0

config BOARD_CUSTOM_STM32F437VI
	bool "Custom STM32F437VI Development Board"
	depends on SOC_STM32F437XX
```

## zephyr/boards/arm/stm32f437vi/Kconfig.defconfig
```kconfig
# Custom board configuration

# Copyright (c) 2023 Your Name.
# SPDX-License-Identifier: Apache-2.0

if BOARD_CUSTOM_STM32F437VI

config BOARD
	default "custom_stm32f437vi"

config SPI_STM32_INTERRUPT
	default y
	depends on SPI

endif # BOARD_CUSTOM_STM32F437VI
```
