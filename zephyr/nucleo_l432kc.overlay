/ {

    leds {
        compatible = "gpio-leds";

        led4: led4 {
            gpios = <&gpiob 3 GPIO_ACTIVE_HIGH>;
            label = "my LED";
        };
    };

    aliases {
        myled = &led4;
    };
};
